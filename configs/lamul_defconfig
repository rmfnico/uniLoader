## configs/lamul_defconfig
```kconfig
CONFIG_POSITION_INDEPENDENT=y
CONFIG_LINUX_KRNL_HEADER_IMG=y
CONFIG_COMPRESS_GZIP=y
CONFIG_EARLYCON=n
CONFIG_SIMPLE_FB=y
CONFIG_MT6768=y
CONFIG_MOTOROLA_LAMUL=y
CONFIG_TEXT_BASE=0x48000000
CONFIG_RAMDISK_ENTRY=0x47c80000
CONFIG_RAMDISK_ENTRY=0x47c80000
CONFIG_PAYLOAD_ENTRY=0x40000000
CONFIG_KERNEL_PATH="blob/Image"
CONFIG_DT_PATH="blob/dtb"
CONFIG_RAMDISK_PATH="blob/ramdisk"
```
